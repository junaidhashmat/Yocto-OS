## build/conf/bblayers.conf
```bitbake
LCONF_VERSION = "7"

BBPATH = "${TOPDIR}"
BSPDIR := "${@os.path.abspath(os.path.dirname(d.getVar('FILE', True)) + '/../..')}"

BBFILES ?= ""
BBLAYERS = " \
  ${BSPDIR}/sources/poky/meta \
  ${BSPDIR}/sources/poky/meta-poky \
  \
  ${BSPDIR}/sources/meta-openembedded/meta-oe \
  ${BSPDIR}/sources/meta-openembedded/meta-multimedia \
  ${BSPDIR}/sources/meta-openembedded/meta-python \
  \
  ${BSPDIR}/sources/meta-freescale \
  ${BSPDIR}/sources/meta-freescale-3rdparty \
  ${BSPDIR}/sources/meta-freescale-distro \
"

BBLAYERS += "${BSPDIR}/sources/meta-browser/meta-chromium"
BBLAYERS += "${BSPDIR}/sources/meta-clang"
BBLAYERS += "${BSPDIR}/sources/meta-openembedded/meta-networking"
BBLAYERS += "${BSPDIR}/sources/meta-openembedded/meta-gnome"
BBLAYERS += "${BSPDIR}/sources/meta-openembedded/meta-filesystems"
BBLAYERS += "${BSPDIR}/sources/meta-openembedded/meta-webserver"
BBLAYERS += "${BSPDIR}/sources/meta-openembedded/meta-perl"
BBLAYERS += "${BSPDIR}/sources/meta-arm/meta-arm"
BBLAYERS += "${BSPDIR}/sources/meta-arm/meta-arm-toolchain"
BBLAYERS += "${BSPDIR}/sources/meta-virtualization"
BBLAYERS += "${BSPDIR}/sources/meta-cloud-services"
BBLAYERS += "${BSPDIR}/sources/meta-security"
BBLAYERS += "${BSPDIR}/sources/meta-qoriq/meta-qoriq-bsp"
BBLAYERS += "${BSPDIR}/sources/meta-qoriq/meta-qoriq-sdk"

# Real-time Edge Yocto Project Release layers
BBLAYERS += "${BSPDIR}/sources/meta-real-time-edge"
BBLAYERS += "${BSPDIR}/sources/meta-atheer"
```

## sources/meta-atheer/conf/layer.conf
```bitbake
# We have a conf and classes directory, add to BBPATH
BBPATH .= ":${LAYERDIR}"

# We have recipes-* directories, add to BBFILES
BBFILES += "${LAYERDIR}/recipes-*/*/*.bb \
            ${LAYERDIR}/recipes-*/*/*.bbappend"

BBFILE_COLLECTIONS += "meta-atheer"
BBFILE_PATTERN_meta-atheer = "^${LAYERDIR}/"
BBFILE_PRIORITY_meta-atheer = "90"

LAYERDEPENDS_meta-atheer = "core"
LAYERSERIES_COMPAT_meta-atheer = "walnascar"
```
